## boards/shields/lets_split_v2/Kconfig.defconfig
```kconfig
# by github.com/mm40

if SHIELD_LETS_SPLIT_V2_LEFT

config ZMK_KEYBOARD_NAME
	default "Let's Split v2"

config ZMK_SPLIT_BLE_ROLE_CENTRAL
	default y

endif

if SHIELD_LETS_SPLIT_V2_LEFT || SHIELD_LETS_SPLIT_V2_RIGHT

config ZMK_SPLIT
	default y

endif
```

## boards/shields/lets_split_v2/Kconfig.shield
```kconfig
# by github.com/mm40

config SHIELD_LETS_SPLIT_V2_LEFT
      def_bool $(shields_list_contains,lets_split_v2_left)

config SHIELD_LETS_SPLIT_V2_RIGHT
      def_bool $(shields_list_contains,lets_split_v2_right)
```
